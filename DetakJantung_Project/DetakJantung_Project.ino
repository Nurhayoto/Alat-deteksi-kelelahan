#include <ESP8266HTTPClient.h>
#include <SPI.h>
#include <ESP8266WiFi.h>
#include <ESP8266WiFiMulti.h>
#include <WiFiClient.h>
#include <Wire.h>
#include <Adafruit_GFX.h>
#include <Adafruit_SSD1306.h>
#include <UrlEncode.h>
#include <PulseSensorPlayground.h> 

//Configure WiFi ssid and password
const char* ssid = "Nurhayoto";
const char* password = "yoto1012";
// siapkan variabel menampung url
//String url;
String phoneNumber = "+6281269767532";
String apiKey = "5533275";

#define SCREEN_WIDTH 128 //--> Lebar OLED Display
#define SCREEN_HEIGHT 64 //--> Tinggi OLED Display
#define OLED_RESET     -1 // Reset pin
Adafruit_SSD1306 display(SCREEN_WIDTH, SCREEN_HEIGHT, &Wire, OLED_RESET);
unsigned long previousMillisGetHR = 0; //--> menyimpan waktu millis ketika sudah diperbaharui (heartbeat)
unsigned long previousMillisResultHR = 0; //--> menyimpan waktu millis ketika sudah diperbaharui (BPM)
const long intervalGetHR = 20; //--> Interval pebacaan.
const long intervalResultHR = 5000; //--> Interval pembacaan setiap 5 detik
int PulseSensorSignal; 
const int PulseSensorHRWire = A0; 
const int BUZZER_PIN = D3; 
int UpperThreshold = 120; 
int LowerThreshold = 60; 
int cntHB = 0; 
boolean ThresholdStat = true; //--> variabel untuk mentriger detak jantung
int detak_jantung = 0; 

int x=0; 
int y=0; 
int lastx=0;
int lasty=0;

//----------------------------------------'HaloTechLogo', 128x64px
const unsigned char HaloTechLogo [] PROGMEM = {
   0x00, 0x00, 0x00, 0x00, 0x00, 0x00, 0x00, 0x00, 0x00, 0x00, 0x00, 0x00, 0x00, 0x00, 0x00, 0x00, 
	0x00, 0x00, 0x00, 0x00, 0x00, 0x00, 0x00, 0x00, 0x00, 0x00, 0x00, 0x00, 0x00, 0x00, 0x00, 0x00, 
	0x00, 0x00, 0x00, 0x00, 0x00, 0x00, 0x00, 0x00, 0x00, 0x00, 0x00, 0x00, 0x00, 0x00, 0x00, 0x00, 
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	0x00, 0x00, 0x00, 0x00, 0x00, 0x00, 0x00, 0x00, 0x00, 0x00, 0x00, 0x00, 0x00, 0x00, 0x00, 0x00
};
//---------------------------------------------------Logo Hati-----------------------------------
const unsigned char Heart_Icon [] PROGMEM = {
  0x00, 0x00, 0x18, 0x30, 0x3c, 0x78, 0x7e, 0xfc, 0xff, 0xfe, 0xff, 0xfe, 0xee, 0xee, 0xd5, 0x56, 
  0x7b, 0xbc, 0x3f, 0xf8, 0x1f, 0xf0, 0x0f, 0xe0, 0x07, 0xc0, 0x03, 0x80, 0x01, 0x00, 0x00, 0x00
};

void setup() {
   pinMode(BUZZER_PIN, OUTPUT);
 Serial.begin(9600); 
  //WAKoper.begin(ssid, pass);
  
 WiFi.begin(ssid, password);
  Serial.println("Connecting");
  while(WiFi.status() != WL_CONNECTED) {
    delay(500);
    Serial.print(".");
  }
  Serial.println("");
  Serial.print("Connected to WiFi network with IP Address: ");
  Serial.println(WiFi.localIP());


  if(!display.begin(SSD1306_SWITCHCAPVCC, 0x3C)) { 
    Serial.println(F("SSD1306 allocation failed"));
    for(;;);
  }  
  //----------------------------------------menampilkan logo
  display.clearDisplay(); 
  display.drawBitmap(0, 0, HaloTechLogo, 128, 64, WHITE);
  display.display();
  delay(3000); 

  //----------------------------------------menampilkan nilai bpm
  display.clearDisplay();
  display.setTextSize(1);
  display.setTextColor(WHITE);
  
  display.setCursor(20, 5);
  display.print("Please Waiting");
    
  display.setCursor(42, 20); 
  display.print("To get");
  
  display.setCursor(4, 35);
  display.print("The Heart Rate value");
  
  display.display(); 
  delay(2000);
  
  //----------------------------------------tampilan pertama mebuat nilai bpm 0
  display.clearDisplay(); 
  display.drawBitmap(0, 47, Heart_Icon, 16, 16, WHITE);
  
  display.drawLine(0, 43, 127, 43, WHITE);
  
  display.setTextSize(2);
  display.setTextColor(WHITE);
  display.setCursor(20, 48); 
  display.print(": 0 BPM");
  display.display(); 
  Serial.println();
  Serial.println("Please wait 10 seconds to get the BPM Value");
}

void loop() { 

  GetHeartRate();
  }

void GetHeartRate() {
  //----------------------------------------proses pembacaan.
  unsigned long currentMillisGetHR = millis();

  if (currentMillisGetHR - previousMillisGetHR >= intervalGetHR) {
    previousMillisGetHR = currentMillisGetHR;

    PulseSensorSignal = analogRead(PulseSensorHRWire);
    Serial.print(PulseSensorSignal);
    Serial.print("   ");

    if (PulseSensorSignal > UpperThreshold && ThresholdStat == true) {
      cntHB++;
      ThresholdStat = false;
    }

    if (PulseSensorSignal < LowerThreshold) {
      ThresholdStat = true;
    }
    
    DrawGraph();
  }
  //Konversi pembacaan Analog ke nilai BPM
  unsigned long currentMillisResultHR = millis();

  if (currentMillisResultHR - previousMillisResultHR >= intervalResultHR) {
    previousMillisResultHR = currentMillisResultHR;

    detak_jantung = cntHB * 6;
    Serial.print("BPM : ");
    Serial.println(detak_jantung);
    
    display.fillRect(20, 48, 108, 18, BLACK);
    
    display.drawBitmap(0, 47, Heart_Icon, 16, 16, WHITE); 
    display.drawLine(0, 43, 127, 43, WHITE); 
  
    display.setTextSize(2);
    display.setTextColor(WHITE);
    display.setCursor(20, 48);
    display.print(": ");
    display.print(detak_jantung);
    display.print(" BPM");
    display.display(); 
   if (detak_jantung < 60 || detak_jantung > 120) {
  digitalWrite(BUZZER_PIN, HIGH);
  Serial.println("anda mengalami kelelahan berkendara");
  
  sendMessage("HEY YOTO detak jantung anda tidak normal, kami peduli dengan keselamatan anda! jika anda merasa lelah saat berkendara,yang harus ada lakukan:Istirahat sejenak sekitar 15-20 menit,Lakukan sedikit peregangan untuk mengembalikan energi dan Minum air.  ");

  
} else {
  digitalWrite(BUZZER_PIN, LOW);
  Serial.println("HEY YOTO anda keadaan normal tetap berhati-hati dalam berkendara dan hindari penggunaan gadget saat berkendara,jika terpaksa mau menggunakn gadget sebaiknya anda menepi dahulu.");
  sendMessage("HEY YOTO anda keadaan normal tetap berhati-hati dalam berkendara dan hindari penggunaan gadget saat berkendara,jika terpaksa mau menggunakan gadget sebaiknya anda menepi dahulu.");

}
    
    cntHB = 0;
  }
}
//--------------------------------------------------------------------------------membuat grafik
void DrawGraph() {
  if (x > 127) {
    display.fillRect(0, 0, 128, 42, BLACK);
    x = 0;
    lastx = 0;
  }
  int ySignal = PulseSensorSignal; 
  
  if (ySignal > 850) ySignal = 850;
  if (ySignal < 350) ySignal = 350;

  int ySignalMap = map(ySignal, 350, 850, 0, 40);    
  
  y = 40 - ySignalMap;
  Serial.println(y);
  display.writeLine(lastx,lasty,x,y,WHITE);
  display.display();   
  lastx = x;
  lasty = y;
  
  x++;
}

void sendMessage(String message){

  // Data to send with HTTP POST
  String url = "http://api.callmebot.com/whatsapp.php?phone=" + phoneNumber + "&apikey=" + apiKey + "&text=" + urlEncode(message);
  WiFiClient client;    
  HTTPClient http;
  http.begin(client, url);

  // Specify content-type header
  http.addHeader("Content-Type", "application/x-www-form-urlencoded");
  
  // Send HTTP POST request
  int httpResponseCode = http.POST(url);
  if (httpResponseCode == 200){
    Serial.print("Message sent successfully");
  }
  else{
    Serial.println("Error sending the message");
    Serial.print("HTTP response code: ");
    Serial.println(httpResponseCode);
  }

  // Free resources
  http.end();
}